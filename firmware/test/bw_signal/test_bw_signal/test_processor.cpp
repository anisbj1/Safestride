// F02 integration tests: SignalProcessor end-to-end — synthetic PPG HR
// accuracy (spec §9), noise/saturation/motion gates, stall/boundary/backlog
// windowing, F28 debug tap and the RAM budget.

#include <cmath>
#include <cstdio>

#include <unity.h>

#include <bw/signal/signal_config.h>
#include <bw/signal/signal_processor.h>

using bw::DataQuality;
using bw::ImuSample;
using bw::PpgSample;
using bw::TimeMs;
namespace signal = bw::signal;

namespace {

constexpr float kTestPi = 3.14159265f;
constexpr float kTestDcIr = 50000.0f;           // plausible MAX30102 DC baseline
constexpr float kTestPulseAmplitude = 1000.0f;  // PI ≈ 1.4 % after filtering
// FIX loop 2b real-data golden (developer ground truth 2026-10-14, same
// wiring/sensor as the bracelet): DC ~163 000 counts (= the measured
// 2540 nA at the 4096 nA range) with pulsatile AC 500–2000 counts at
// 65–70 bpm — the band in which the tester reads BPM comfortably. AC here
// is the sine PEAK amplitude in counts (PI = ac_rms/dc = A/(sqrt(2)*dc)).
constexpr float kRealDataDcIr = 163000.0f;
constexpr float kRealDataAcWeak = 600.0f;     // weak end: PI ≈ 0.26 %
constexpr float kRealDataAcStrong = 1500.0f;  // clear pulse: PI ≈ 0.65 %
// FIX 2026-10-15 (hr_valid decoupling): below the tester's 500–2000 pulse
// band — PI = 300/(sqrt(2)*163000) ≈ 0.13 % ⇒ pi_factor 0.1 ⇒ quality stays
// Insufficient, yet the train is regular and detectable (filtered peak ≈ 294
// > the 0.1 % PI floor ≈ 163): the bench's weak-contact windows that must
// now read `HR ~70?` instead of `HR --`.
constexpr float kRealDataAcFaint = 300.0f;
// FIX loop 4 (jitter fixture): ±50 % beat-to-beat amplitude jitter about a
// 1200-count mean (the bench's real variability class, round 7) at DC
// 160 000 — mean PI ≈ 0.53 % (well above the floor, so quality would be
// Good if the beats were all detected; only detection may fail here).
constexpr float kJitterDcIr = 160000.0f;
constexpr float kJitterAmpHigh = 1800.0f;
constexpr float kJitterAmpLow = 600.0f;

// FIX loop 3 starvation fixture: rhythmic motion-artifact burst. 1.5 Hz
// sits mid-band in the 0.5–4 Hz passband (chain gain ≈ unity), so the
// detector sees its crests as giant beats — the in-band transient class
// that seeded amp_ema_ on the bench (round 3: thr frozen at 5080 while
// pulse peaks reached 1875). Amplitude keeps raw crests at 183 000
// counts < 262 143 → no saturation. Duration covers 4 crests (667 ms
// apart, all outside the 300 ms refractory), ending on a near-zero
// crossing so the chain has no large ring-down edge after the burst.
constexpr float kBurstFreqHz = 1.5f;
constexpr float kBurstAmplitude = 20000.0f;
constexpr TimeMs kBurstStartMs = 2000;
constexpr TimeMs kBurstDurationMs = 2333;

PpgSample mkPpg(TimeMs t, float pulse_amplitude, float freq_hz, bool saturated = false,
                float dc_ir = kTestDcIr) {
    PpgSample s{};
    s.t_ms = t;
    const float x =
        dc_ir + pulse_amplitude * std::sin(2.0f * kTestPi * freq_hz * static_cast<float>(t) /
                                           static_cast<float>(signal::kMsPerSecond));
    s.ir = static_cast<uint32_t>(x);
    s.red = s.ir;
    s.saturated = saturated;
    return s;
}

ImuSample mkQuietImu(TimeMs t) {
    ImuSample s{};
    s.t_ms = t;
    s.accel_g[0] = 0.0f;
    s.accel_g[1] = 0.0f;
    s.accel_g[2] = 1.0f;
    return s;
}

ImuSample mkMotionImu(TimeMs t) {
    // |a| = 1.5 g ⇒ ENMO 0.5 g, far above kMaxMotionForValidHrEnmoG.
    ImuSample s{};
    s.t_ms = t;
    s.accel_g[0] = 0.0f;
    s.accel_g[1] = 0.0f;
    s.accel_g[2] = 1.5f;
    return s;
}

void feedSecond(signal::SignalProcessor& p, TimeMs base_ms, float pulse_amplitude, float freq_hz,
                bool saturated = false, bool motion = false, float dc_ir = kTestDcIr) {
    PpgSample ppg[100];
    for (uint32_t i = 0; i < 100; ++i) {
        ppg[i] = mkPpg(base_ms + i * signal::kPpgSamplePeriodMs, pulse_amplitude, freq_hz,
                       saturated, dc_ir);
    }
    p.feedPpg(ppg, 100);
    ImuSample imu[50];
    for (uint32_t i = 0; i < 50; ++i) {
        const TimeMs t = base_ms + i * signal::kImuSamplePeriodMs;
        imu[i] = motion ? mkMotionImu(t) : mkQuietImu(t);
    }
    p.feedImu(imu, 50);
}

// DoD §14 evidence: prints one row of the synthetic-HR accuracy table so the
// numbers recorded in the spec's status log can be regenerated by re-running
// the suite (table lives in the spec, not in assertions alone).
void printHrAccuracyRow(float expected_bpm, const signal::SignalWindowOutput& out) {
    printf("[F02 DoD] expected %.0f bpm | measured %.2f bpm | err %+.2f | sqi %.3f | "
           "conf %.3f | valid %d | quality %d\n",
           expected_bpm, out.ppg.hr_bpm, out.ppg.hr_bpm - expected_bpm, out.ppg.sqi,
           out.ppg.hr_confidence, static_cast<int>(out.ppg.hr_valid),
           static_cast<int>(out.ppg.quality));
}

// Closes windows the way the 1 s ProcessingTask would after feeding this
// second (now is past window_end + kMaxSampleGapMs).
void closeDueWindows(signal::SignalProcessor& p, TimeMs now_ms, signal::SignalWindowOutput& last,
                     int& closed) {
    signal::SignalWindowOutput out{};
    while (p.step(now_ms, out)) {
        last = out;
        ++closed;
    }
}

}  // namespace

void test_processor_hr_synthetic_70bpm() {
    signal::SignalProcessor p;
    signal::SignalWindowOutput last{};
    int closed = 0;
    for (int sec = 0; sec < 12; ++sec) {
        const TimeMs base = static_cast<TimeMs>(sec) * signal::kMotionWindowMs;
        feedSecond(p, base, kTestPulseAmplitude, 70.0f / 60.0f);
        closeDueWindows(p, base + signal::kMotionWindowMs + signal::kMaxSampleGapMs, last, closed);
    }
    TEST_ASSERT_EQUAL_INT(12, closed);
    TEST_ASSERT_EQUAL(static_cast<int>(DataQuality::Good), static_cast<int>(last.ppg.quality));
    TEST_ASSERT_TRUE(last.ppg.hr_valid);
    // Spec §9 target: within ±3 bpm [EXPERIMENTAL].
    TEST_ASSERT_FLOAT_WITHIN(3.0f, 70.0f, last.ppg.hr_bpm);
    TEST_ASSERT_TRUE(last.ppg.hr_confidence > 0.4f);
    TEST_ASSERT_FALSE(last.ppg.motion_corrupted);
    // Motion side of the same window: quiet IMU ⇒ Good, no motion.
    TEST_ASSERT_EQUAL(static_cast<int>(DataQuality::Good), static_cast<int>(last.motion.quality));
    TEST_ASSERT_FLOAT_WITHIN(0.001f, 0.0f, last.motion.enmo_g);
    printHrAccuracyRow(70.0f, last);
}

void test_processor_hr_synthetic_50bpm() {
    signal::SignalProcessor p;
    signal::SignalWindowOutput last{};
    int closed = 0;
    for (int sec = 0; sec < 12; ++sec) {
        const TimeMs base = static_cast<TimeMs>(sec) * signal::kMotionWindowMs;
        feedSecond(p, base, kTestPulseAmplitude, 50.0f / 60.0f);
        closeDueWindows(p, base + signal::kMotionWindowMs + signal::kMaxSampleGapMs, last, closed);
    }
    TEST_ASSERT_TRUE(closed >= 11);
    TEST_ASSERT_TRUE(last.ppg.hr_valid);
    TEST_ASSERT_FLOAT_WITHIN(3.0f, 50.0f, last.ppg.hr_bpm);
    printHrAccuracyRow(50.0f, last);
}

void test_processor_hr_synthetic_120bpm() {
    signal::SignalProcessor p;
    signal::SignalWindowOutput last{};
    int closed = 0;
    for (int sec = 0; sec < 12; ++sec) {
        const TimeMs base = static_cast<TimeMs>(sec) * signal::kMotionWindowMs;
        feedSecond(p, base, kTestPulseAmplitude, 120.0f / 60.0f);
        closeDueWindows(p, base + signal::kMotionWindowMs + signal::kMaxSampleGapMs, last, closed);
    }
    TEST_ASSERT_TRUE(closed >= 11);
    TEST_ASSERT_TRUE(last.ppg.hr_valid);
    TEST_ASSERT_FLOAT_WITHIN(3.0f, 120.0f, last.ppg.hr_bpm);
    printHrAccuracyRow(120.0f, last);
}

void test_processor_hr_realdata_golden() {
    // DoD §14 REAL-DATA golden rows (F02 FIX loop 2b, developer ground
    // truth 2026-10-14: on this exact sensor/wiring the tester reads BPM
    // comfortably at DC ~163 000 counts with pulsatile AC 500–2000 counts,
    // 65–70 bpm). Two rows, AC = sine peak amplitude in counts:
    //   weak end  600 -> PI = 600/(sqrt(2)*163000) ≈ 0.26 % -> pi_factor
    //             (0.0026-0.001)/(0.004-0.001) ≈ 0.53 > kMinSqiForValidHr
    //   clear    1500 -> PI ≈ 0.65 % -> pi_factor clamps to 1.0
    // Both must reach quality Good + hr_valid. This pins the H3 loop-2b
    // recalibration of kSqiFullPerfusionRef (0.01 -> 0.004): reverting it
    // caps the weak row at sqi ≈ 0.18 → Insufficient → test FAILS.
    signal::SignalProcessor p;
    signal::SignalWindowOutput last{};
    int closed = 0;
    for (int sec = 0; sec < 12; ++sec) {
        const TimeMs base = static_cast<TimeMs>(sec) * signal::kMotionWindowMs;
        feedSecond(p, base, kRealDataAcWeak, 70.0f / 60.0f, false, false, kRealDataDcIr);
        closeDueWindows(p, base + signal::kMotionWindowMs + signal::kMaxSampleGapMs, last, closed);
    }
    TEST_ASSERT_TRUE(closed >= 11);
    TEST_ASSERT_EQUAL(static_cast<int>(DataQuality::Good), static_cast<int>(last.ppg.quality));
    TEST_ASSERT_TRUE(last.ppg.hr_valid);
    TEST_ASSERT_FLOAT_WITHIN(3.0f, 70.0f, last.ppg.hr_bpm);
    printHrAccuracyRow(70.0f, last);

    signal::SignalProcessor p2;
    closed = 0;
    for (int sec = 0; sec < 12; ++sec) {
        const TimeMs base = static_cast<TimeMs>(sec) * signal::kMotionWindowMs;
        feedSecond(p2, base, kRealDataAcStrong, 65.0f / 60.0f, false, false, kRealDataDcIr);
        closeDueWindows(p2, base + signal::kMotionWindowMs + signal::kMaxSampleGapMs, last, closed);
    }
    TEST_ASSERT_TRUE(closed >= 11);
    TEST_ASSERT_EQUAL(static_cast<int>(DataQuality::Good), static_cast<int>(last.ppg.quality));
    TEST_ASSERT_TRUE(last.ppg.hr_valid);
    TEST_ASSERT_FLOAT_WITHIN(3.0f, 65.0f, last.ppg.hr_bpm);
    printHrAccuracyRow(65.0f, last);
}

void test_processor_beat_starvation_recovers() {
    // FIX loop 3 (bench round 3, hr_finger_round3_20261015.out): ONE early
    // transient was accepted as beats and seeded amp_ema_; the then-adaptive
    // threshold froze at 5080 for the whole 90 s run while pulse peaks
    // reached only 1875 → nab = 0, b = 0, no HR: a self-locking threshold
    // (amp_ema_ updated only on accepted beats, so it could never decay).
    // FIX loop 4 deleted that amplitude-coupled state entirely (ratchet
    // class gone by construction), so this fixture is RETAINED as the
    // regression guard for what it also exercises: an in-band artifact
    // burst must not permanently poison detection — the burst crests are
    // accepted as beats while it lasts (above the floor, outside the
    // refractory — the already-accepted noise trade), and the real 70 bpm
    // train must own every window after it ends.
    // Fixture: real-data DC + 70 bpm sine (AC peak 1500 → filtered peak
    // ≈ 1470), plus a rhythmic motion-artifact burst at t = 2 s: 1.5 Hz
    // sits in the middle of the 0.5–4 Hz passband, so the chain passes its
    // crests at ~unity — exactly the in-band transient class a finger
    // jostle produces.
    // Named fixture constants (see below): kBurstFreqHz, kBurstAmplitude,
    // kBurstStartMs, kBurstDurationMs.
    signal::SignalProcessor p;
    signal::SignalWindowOutput last{};
    int closed = 0;
    for (int sec = 0; sec < 60; ++sec) {
        const TimeMs base = static_cast<TimeMs>(sec) * signal::kMotionWindowMs;
        PpgSample ppg[100];
        for (uint32_t i = 0; i < 100; ++i) {
            const TimeMs t = base + i * signal::kPpgSamplePeriodMs;
            ppg[i] = mkPpg(t, kRealDataAcStrong, 70.0f / 60.0f, false, kRealDataDcIr);
            if (t >= kBurstStartMs && t < kBurstStartMs + kBurstDurationMs) {
                // rhythmic motion artifact, zero-mean: crests reach
                // 163 000 + 20 000 = 183 000 < 262 143 → no saturation.
                const float artifact =
                    kBurstAmplitude *
                    std::sin(2.0f * kTestPi * kBurstFreqHz * static_cast<float>(t - kBurstStartMs) /
                             static_cast<float>(signal::kMsPerSecond));
                ppg[i].ir = static_cast<uint32_t>(static_cast<int32_t>(ppg[i].ir) +
                                                  static_cast<int32_t>(artifact));
                ppg[i].red = ppg[i].ir;
            }
        }
        p.feedPpg(ppg, 100);
        ImuSample imu[50];
        for (uint32_t i = 0; i < 50; ++i) {
            imu[i] = mkQuietImu(base + i * signal::kImuSamplePeriodMs);
        }
        p.feedImu(imu, 50);
        closeDueWindows(p, base + signal::kMotionWindowMs + signal::kMaxSampleGapMs, last, closed);
    }
    TEST_ASSERT_TRUE(closed >= 55);
    // Beats resumed after the transient: the last window carries a full HR
    // lookback of real beats (frozen-threshold code yields 0 here).
    TEST_ASSERT_TRUE(last.ppg_beat_count >= signal::kMinBeatsForHr);
    TEST_ASSERT_TRUE(last.ppg.hr_valid);
    TEST_ASSERT_EQUAL(static_cast<int>(DataQuality::Good), static_cast<int>(last.ppg.quality));
    TEST_ASSERT_FLOAT_WITHIN(3.0f, 70.0f, last.ppg.hr_bpm);
    // The threshold IS the 0.1 % DC floor (≈ 163 at DC 163 k) since FIX
    // loop 4 — there is no amplitude-coupled bar left that the burst could
    // freeze (loop 3's bench freeze was 5080).
    TEST_ASSERT_TRUE(last.ppg_peak_threshold > 0.0f);
    TEST_ASSERT_TRUE(last.ppg_peak_threshold < 1200.0f);
    TEST_ASSERT_TRUE(last.ppg_peaks_above_threshold > 0u);
    printHrAccuracyRow(70.0f, last);
}

void test_processor_noise_above_floor_never_reports_good_quality() {  // FIX loop-3 honesty test,
                                                                      // RE-SCOPED 2026-10-15
                                                                      // (renamed from
    // ..._never_valid_hr when the developer decoupled hr_valid from quality):
    // noise ABOVE the 0.1 % floor (±800 counts at
    // real-data DC) — after a starvation re-seed the threshold sits at the
    // floor, so false beats ARE accepted (deterministic LCG: b=5 by sec 2).
    // The old per-window hr_valid assert encoded the coupled predicate
    // (quality Good && plausibility) that no longer exists: a random train
    // CAN pass the plausibility triple (first occurrence: sec 2, 117.6 bpm,
    // conf 0.00) — the same accepted class as the motion false-HR (round 5:
    // 153.8) that renders as "HR ~118?" with doubt. What must NEVER happen
    // for pure noise: quality Good (the sqi timing factor stays 0 for
    // erratic trains) and confidence at/above kMinSqiForValidHr — honesty
    // now lives in quality + confidence (+ F13's own quality/confidence
    // gates), not in
    // hiding the number. The classic noise-only fixture (no perfusion, peaks
    // below the floor → zero beats) separately pins hr_valid=false, unchanged.
    signal::SignalProcessor p;
    signal::SignalWindowOutput last{};
    int closed = 0;
    uint32_t lcg = 24680u;  // fixed seed: deterministic noise, no rand()
    for (int sec = 0; sec < 30; ++sec) {
        const TimeMs base = static_cast<TimeMs>(sec) * signal::kMotionWindowMs;
        PpgSample ppg[100];
        for (uint32_t i = 0; i < 100; ++i) {
            lcg = lcg * 1664525u + 1013904223u;
            const int32_t noise = static_cast<int32_t>((lcg >> 16) % 1601u) - 800;
            ppg[i] = mkPpg(base + i * signal::kPpgSamplePeriodMs, 0.0f, 0.0f, false, kRealDataDcIr);
            ppg[i].ir = static_cast<uint32_t>(static_cast<int32_t>(kRealDataDcIr) + noise);
            ppg[i].red = ppg[i].ir;
        }
        p.feedPpg(ppg, 100);
        ImuSample imu[50];
        for (uint32_t i = 0; i < 50; ++i) {
            imu[i] = mkQuietImu(base + i * signal::kImuSamplePeriodMs);
        }
        p.feedImu(imu, 50);
        closeDueWindows(p, base + signal::kMotionWindowMs + signal::kMaxSampleGapMs, last, closed);
        // Never Good, never confident — every window, not just the last.
        TEST_ASSERT_NOT_EQUAL(static_cast<int>(DataQuality::Good),
                              static_cast<int>(last.ppg.quality));
        TEST_ASSERT_TRUE(last.ppg.hr_confidence < signal::kMinSqiForValidHr);
    }
    TEST_ASSERT_TRUE(closed >= 28);
}

void test_processor_noise_only_insufficient() {
    // Noise-only stream: no perfusion (PI < 0.1 %) ⇒ spec §9 requires
    // hr_valid = false, quality = Insufficient.
    signal::SignalProcessor p;
    signal::SignalWindowOutput last{};
    int closed = 0;
    uint32_t lcg = 12345u;  // fixed seed: deterministic noise, no rand()
    for (int sec = 0; sec < 8; ++sec) {
        const TimeMs base = static_cast<TimeMs>(sec) * signal::kMotionWindowMs;
        PpgSample ppg[100];
        for (uint32_t i = 0; i < 100; ++i) {
            lcg = lcg * 1664525u + 1013904223u;
            const int32_t noise = static_cast<int32_t>((lcg >> 16) % 61u) - 30;
            ppg[i] = mkPpg(base + i * signal::kPpgSamplePeriodMs, 0.0f, 0.0f);
            ppg[i].ir = static_cast<uint32_t>(static_cast<int32_t>(kTestDcIr) + noise);
            ppg[i].red = ppg[i].ir;
        }
        p.feedPpg(ppg, 100);
        ImuSample imu[50];
        for (uint32_t i = 0; i < 50; ++i) {
            imu[i] = mkQuietImu(base + i * signal::kImuSamplePeriodMs);
        }
        p.feedImu(imu, 50);
        closeDueWindows(p, base + signal::kMotionWindowMs + signal::kMaxSampleGapMs, last, closed);
    }
    TEST_ASSERT_TRUE(closed > 0);
    TEST_ASSERT_EQUAL(static_cast<int>(DataQuality::Insufficient),
                      static_cast<int>(last.ppg.quality));
    TEST_ASSERT_FALSE(last.ppg.hr_valid);
    TEST_ASSERT_FLOAT_WITHIN(0.0001f, 0.0f, last.ppg.hr_bpm);
    TEST_ASSERT_TRUE(last.ppg.sqi < signal::kMinSqiForValidHr);
}

void test_processor_saturated_insufficient() {
    signal::SignalProcessor p;
    signal::SignalWindowOutput last{};
    int closed = 0;
    for (int sec = 0; sec < 8; ++sec) {
        const TimeMs base = static_cast<TimeMs>(sec) * signal::kMotionWindowMs;
        feedSecond(p, base, kTestPulseAmplitude, 70.0f / 60.0f,
                   /*saturated=*/true);
        closeDueWindows(p, base + signal::kMotionWindowMs + signal::kMaxSampleGapMs, last, closed);
    }
    TEST_ASSERT_TRUE(closed > 0);
    TEST_ASSERT_EQUAL(static_cast<int>(DataQuality::Insufficient),
                      static_cast<int>(last.ppg.quality));
    // 2026-10-15 semantic change: the saturation FLAG is a quality input and
    // no longer gates validity. The fixture's values are an uncut regular
    // sine, so the beat train is plausible → hr_valid=true while quality
    // stays Insufficient (F12 renders "HR ~70?"). Real ADC clipping
    // flat-tops the pulse and jitters the timing — the estimator's
    // consistency gate is the honesty floor for genuinely mangled trains.
    TEST_ASSERT_TRUE(last.ppg.hr_valid);
    TEST_ASSERT_FLOAT_WITHIN(3.0f, 70.0f, last.ppg.hr_bpm);  // train still read
    TEST_ASSERT_FLOAT_WITHIN(0.0001f, 0.0f, last.ppg.sqi);
    // FIX-1 diagnostics: every sample flagged saturated must surface in the
    // per-window fraction the [PPGWIN] bench line prints.
    TEST_ASSERT_FLOAT_WITHIN(0.0001f, 1.0f, last.ppg_saturated_fraction);
}

void test_processor_hr_valid_when_quality_insufficient() {
    // FIX 2026-10-15 (developer-directed, hr_valid decoupled from the quality
    // gate): a bench-weak pulse train — DC 163 000, AC 300 (PI ≈ 0.13 %, the
    // 6-round bench's mostly-0.0006–0.0024 regime) — must keep quality
    // Insufficient (the sqi gate is UNCHANGED) while hr_valid turns true on
    // plausibility alone: beats ≥ kMinBeatsForHr, median IBI physiological,
    // consistency ≥ kMinIbiConsistencyFraction. This is the fixture that
    // decided the OLED showed `--` for six rounds: the number now exists,
    // quality still says "not reliable" (F12 renders `HR ~70?`), and
    // hr_confidence = sqi × consistency stays honestly low.
    signal::SignalProcessor p;
    signal::SignalWindowOutput last{};
    int closed = 0;
    for (int sec = 0; sec < 12; ++sec) {
        const TimeMs base = static_cast<TimeMs>(sec) * signal::kMotionWindowMs;
        feedSecond(p, base, kRealDataAcFaint, 70.0f / 60.0f, false, false, kRealDataDcIr);
        closeDueWindows(p, base + signal::kMotionWindowMs + signal::kMaxSampleGapMs, last, closed);
    }
    TEST_ASSERT_TRUE(closed >= 11);
    // Quality gate untouched: still too little perfusion for Good.
    TEST_ASSERT_EQUAL(static_cast<int>(DataQuality::Insufficient),
                      static_cast<int>(last.ppg.quality));
    TEST_ASSERT_TRUE(last.ppg.sqi < signal::kMinSqiForValidHr);
    // The decoupled output: plausible train → valid + a real number.
    TEST_ASSERT_TRUE(last.ppg.hr_valid);
    TEST_ASSERT_FLOAT_WITHIN(3.0f, 70.0f, last.ppg.hr_bpm);
    // ...but confidence carries the doubt honestly (sqi × consistency).
    TEST_ASSERT_TRUE(last.ppg.hr_confidence < signal::kMinSqiForValidHr);
}

void test_processor_hr_survives_amplitude_jitter() {  // FIX loop 4 (bench round 7): steady contact,
                                                      // HR read correctly at first,
    // then dropped to "--" periodically and returned 10–20 s later. Root
    // cause: the adaptive threshold THR = 0.5 × amp_ema_ is a RATCHET —
    // amp_ema_ updates only on accepted beats, real beat amplitudes vary
    // 30–100 % beat-to-beat, so weak real beats fall below 0.5 × the recent
    // amplitude, are missed, IBI consistency collapses (hr_valid → "--"),
    // and only the 10 s starvation re-seed restores detection until a
    // strong beat reinflates the EMA. Fixture: DC 160 000, 70 bpm, beat
    // amplitude alternating 1800 / 600 counts (±50 % about the 1200 mean —
    // deterministic per-second modulation, no RNG), 60 s, quiet IMU. The
    // invariant: a jittered-but-regular train must keep hr_valid in ≥95 %
    // of windows with the correct median bpm — no starvation episodes.
    signal::SignalProcessor p;
    signal::SignalWindowOutput last{};
    int closed = 0;
    int valid_windows = 0;
    for (int sec = 0; sec < 60; ++sec) {
        const TimeMs base = static_cast<TimeMs>(sec) * signal::kMotionWindowMs;
        const float amp = (sec % 2 == 0) ? kJitterAmpHigh : kJitterAmpLow;
        const int before = closed;
        feedSecond(p, base, amp, 70.0f / 60.0f, /*saturated=*/false, /*motion=*/false, kJitterDcIr);
        closeDueWindows(p, base + signal::kMotionWindowMs + signal::kMaxSampleGapMs, last, closed);
        if (closed > before && last.ppg.hr_valid) {
            ++valid_windows;
        }
    }
    TEST_ASSERT_TRUE(closed >= 57);
    // ≥95 % of windows valid (integer form: no float rounding games).
    TEST_ASSERT_TRUE(valid_windows * 100 >= closed * 95);
    TEST_ASSERT_TRUE(last.ppg.hr_valid);
    TEST_ASSERT_FLOAT_WITHIN(3.0f, 70.0f, last.ppg.hr_bpm);
}

// ---- FIX loop 5 (hr_valid lifetime policy, bench round 7) ---------------
namespace {

// FIX loop 5 (T4 arrhythmia fixture): half-sine pulse bumps at caller-given
// beat times. Unlike mkPpg's continuous sine this places beats at EXACT
// irregular intervals (the arrhythmia class) with no phase glitches, so a
// rejection at the end proves the plausibility gate + hold discipline, not
// a synthesis artifact. Bump width 200 ms sits inside the 0.5–4 Hz passband.
constexpr TimeMs kPulseBumpWidthMs = 200;

// Feeds the [base_ms, base_ms + 1000) slice of a pulse train (quiet IMU
// included, same shape as feedSecond) — one second per call so tests can
// close windows per second.
void feedPulseTrainSecond(signal::SignalProcessor& p, TimeMs base_ms, const TimeMs* beat_offsets,
                          uint32_t beat_count, float dc_ir, float amp) {
    PpgSample ppg[100];
    for (uint32_t i = 0; i < 100; ++i) {
        const TimeMs st = base_ms + i * signal::kPpgSamplePeriodMs;
        float x = dc_ir;
        for (uint32_t b = 0; b < beat_count; ++b) {
            const TimeMs bt = beat_offsets[b];
            if (st >= bt && st - bt < kPulseBumpWidthMs) {
                x += amp * std::sin(kTestPi * static_cast<float>(st - bt) /
                                    static_cast<float>(kPulseBumpWidthMs));
            }
        }
        PpgSample s{};
        s.t_ms = st;
        s.ir = static_cast<uint32_t>(x);
        s.red = s.ir;
        s.saturated = false;
        ppg[i] = s;
    }
    p.feedPpg(ppg, 100);
    ImuSample imu[50];
    for (uint32_t i = 0; i < 50; ++i) {
        imu[i] = mkQuietImu(base_ms + i * signal::kImuSamplePeriodMs);
    }
    p.feedImu(imu, 50);
}

}  // namespace

void test_processor_hr_valid_holds_through_weak_dip() {  // FIX loop 5 (bench round 7): the
    // 14 s `hr_valid=false` stretch at t=42–55 s under steady contact.
    // Fixture: the loop-4 jitter train (DC 160 000, 70 bpm, ±50 % amplitude
    // jitter) plus a 4 s WEAK-PERFUSION dip at seconds 30–33 — sine amp 600
    // (PI ≈ 0.0027, the round-7 0.0022–0.0037 regime) + ±800-count band
    // noise (deterministic LCG, the same above-the-floor false-beat regime
    // the noise test pins) so false/jittered beats poison the IBI train
    // exactly like the bench's weak windows. Before the fix the
    // FULL-window consistency failed for as long as the poisoned IBIs sat
    // in the 10 s lookback → `--` flicker under steady contact. After:
    // consistency is judged over the recent IBIs and the HOLD bridges the
    // dip + its age-out tail — hr_valid must stay true through EVERY window
    // from dip start through full recovery (dip end + 6 s), and the bpm
    // keeps tracking 70 (the full-window median stays on the clean
    // majority).
    signal::SignalProcessor p;
    signal::SignalWindowOutput last{};
    int closed = 0;
    int dip_windows = 0;
    int dip_invalid = 0;
    uint32_t lcg = 424242u;  // fixed seed: deterministic dip noise, no rand()
    for (int sec = 0; sec < 60; ++sec) {
        const TimeMs base = static_cast<TimeMs>(sec) * signal::kMotionWindowMs;
        const int before = closed;
        if (sec >= 30 && sec < 34) {
            PpgSample ppg[100];
            for (uint32_t i = 0; i < 100; ++i) {
                lcg = lcg * 1664525u + 1013904223u;
                const int32_t noise = static_cast<int32_t>((lcg >> 16) % 1601u) - 800;
                const TimeMs st = base + i * signal::kPpgSamplePeriodMs;
                const float x =
                    kJitterDcIr +
                    600.0f * std::sin(2.0f * kTestPi * (70.0f / 60.0f) * static_cast<float>(st) /
                                      static_cast<float>(signal::kMsPerSecond)) +
                    static_cast<float>(noise);
                ppg[i] = mkPpg(st, 0.0f, 0.0f, false, kJitterDcIr);
                ppg[i].ir = static_cast<uint32_t>(x);
                ppg[i].red = ppg[i].ir;
            }
            p.feedPpg(ppg, 100);
            ImuSample imu[50];
            for (uint32_t i = 0; i < 50; ++i) {
                imu[i] = mkQuietImu(base + i * signal::kImuSamplePeriodMs);
            }
            p.feedImu(imu, 50);
        } else {
            const float amp = (sec % 2 == 0) ? kJitterAmpHigh : kJitterAmpLow;
            feedSecond(p, base, amp, 70.0f / 60.0f, /*saturated=*/false, /*motion=*/false,
                       kJitterDcIr);
        }
        closeDueWindows(p, base + signal::kMotionWindowMs + signal::kMaxSampleGapMs, last, closed);
        if (closed > before && last.window_end_ms >= 30000 && last.window_end_ms <= 40000) {
            ++dip_windows;
            if (!last.ppg.hr_valid) {
                ++dip_invalid;
                printf("[T1] DIP/RECOVERY window end=%u hr_valid=0 bpm=%.1f\n",
                       static_cast<unsigned>(last.window_end_ms), last.ppg.hr_bpm);
            }
        }
    }
    TEST_ASSERT_TRUE(closed >= 57);
    TEST_ASSERT_TRUE(dip_windows >= 8);  // the range actually got windows
    TEST_ASSERT_EQUAL(0, dip_invalid);   // hold: no `--` during/after the dip
    TEST_ASSERT_TRUE(last.ppg.hr_valid);
    TEST_ASSERT_FLOAT_WITHIN(3.0f, 70.0f, last.ppg.hr_bpm);
}

void test_processor_hr_clears_within_gap_when_pulse_stops() {  // FIX loop 5 (round-7 ghost):
    // the user lifts the finger and the number lingers because the 10 s
    // beat lookback keeps the last train "plausible". Fixture: valid train
    // 12 s, then SILENCE (no samples at all — windows still close via the
    // stall rule, spec §10). The gap rule must clear hr_valid within
    // kIbiPlausibleMaxMs of the last accepted beat + one window, so the
    // hold can never outlive an actual beat gap; before the fix the
    // lookback held the number alive until the beats aged out (~7 s later).
    signal::SignalProcessor p;
    signal::SignalWindowOutput last{};
    int closed = 0;
    for (int sec = 0; sec < 12; ++sec) {
        const TimeMs base = static_cast<TimeMs>(sec) * signal::kMotionWindowMs;
        feedSecond(p, base, kTestPulseAmplitude, 70.0f / 60.0f);
        closeDueWindows(p, base + signal::kMotionWindowMs + signal::kMaxSampleGapMs, last, closed);
    }
    // Premise: the train was valid before contact loss (otherwise there is
    // no ghost to bound).
    TEST_ASSERT_TRUE(last.ppg.hr_valid);
    const TimeMs last_data_end = last.window_end_ms;
    // Silence: close windows without feeding anything.
    TimeMs first_invalid_end = 0;
    for (int sec = 12; sec < 24; ++sec) {
        const TimeMs base = static_cast<TimeMs>(sec) * signal::kMotionWindowMs;
        const int before = closed;
        closeDueWindows(p, base + signal::kMotionWindowMs + signal::kMaxSampleGapMs, last, closed);
        if (closed > before && !last.ppg.hr_valid && first_invalid_end == 0) {
            first_invalid_end = last.window_end_ms;
        }
    }
    printf("[T2] last_data_end=%u first_invalid_end=%u (delta=%u)\n",
           static_cast<unsigned>(last_data_end), static_cast<unsigned>(first_invalid_end),
           static_cast<unsigned>(first_invalid_end - last_data_end));
    TEST_ASSERT_TRUE(closed >= 23);
    TEST_ASSERT_TRUE(first_invalid_end != 0);  // it does clear (not a 10 s ghost)
    // Ghost bound: within the gap rule + one window of the last data window.
    TEST_ASSERT_TRUE(first_invalid_end - last_data_end <= signal::kIbiPlausibleMaxMs +
                                                              signal::kMotionWindowMs +
                                                              signal::kMaxSampleGapMs);
    TEST_ASSERT_FALSE(last.ppg.hr_valid);
}

void test_processor_hr_first_display_latency() {  // FIX loop 5 (round 7): time-to-first-display
    // was 14 s on the bench (detection started at t=3 s) because the
    // FULL-window consistency kept the jittery contact-onset IBIs in the
    // gate until they aged out. Fixture: onset seconds 0–2 = weak pulse
    // (amp 600) + ±550-count band noise above the floor (false/shifted
    // beats — the bench's settling class), clean seconds 3–12 (amp 1200,
    // DC 160 000, 70 bpm). With consistency over the RECENT IBIs the clean
    // train is judged on its own rhythm: first plausible verdict within
    // ~6–8 s of contact onset, and it must STAY valid after. (Before-fix
    // evidence: the same policy measured on a harsher ±700/4 s onset gave
    // first display at 9000 ms — and the bench round 7 measured 14 s; the
    // full-window MEDIAN age-out, which this loop deliberately does not
    // touch, caps very-harsh onsets — see the status log.)
    signal::SignalProcessor p;
    signal::SignalWindowOutput last{};
    int closed = 0;
    TimeMs first_valid_end = 0;
    uint32_t lcg = 13579u;  // fixed seed: deterministic onset noise
    for (int sec = 0; sec < 12; ++sec) {
        const TimeMs base = static_cast<TimeMs>(sec) * signal::kMotionWindowMs;
        const int before = closed;
        if (sec < 3) {
            PpgSample ppg[100];
            for (uint32_t i = 0; i < 100; ++i) {
                lcg = lcg * 1664525u + 1013904223u;
                const int32_t noise = static_cast<int32_t>((lcg >> 16) % 1101u) - 550;
                const TimeMs st = base + i * signal::kPpgSamplePeriodMs;
                const float x =
                    kJitterDcIr +
                    600.0f * std::sin(2.0f * kTestPi * (70.0f / 60.0f) * static_cast<float>(st) /
                                      static_cast<float>(signal::kMsPerSecond)) +
                    static_cast<float>(noise);
                ppg[i] = mkPpg(st, 0.0f, 0.0f, false, kJitterDcIr);
                ppg[i].ir = static_cast<uint32_t>(x);
                ppg[i].red = ppg[i].ir;
            }
            p.feedPpg(ppg, 100);
            ImuSample imu[50];
            for (uint32_t i = 0; i < 50; ++i) {
                imu[i] = mkQuietImu(base + i * signal::kImuSamplePeriodMs);
            }
            p.feedImu(imu, 50);
        } else {
            feedSecond(p, base, 1200.0f, 70.0f / 60.0f, /*saturated=*/false, /*motion=*/false,
                       kJitterDcIr);
        }
        closeDueWindows(p, base + signal::kMotionWindowMs + signal::kMaxSampleGapMs, last, closed);
        if (closed > before && first_valid_end == 0 && last.ppg.hr_valid) {
            first_valid_end = last.window_end_ms;
        }
    }
    printf("[T3] first_valid_end=%u\n", static_cast<unsigned>(first_valid_end));
    TEST_ASSERT_TRUE(first_valid_end != 0);
    TEST_ASSERT_TRUE(first_valid_end <= 8500);  // ~6–8 s of contact onset
    TEST_ASSERT_TRUE(last.ppg.hr_valid);        // stays on after first display
    TEST_ASSERT_FLOAT_WITHIN(3.0f, 70.0f, last.ppg.hr_bpm);
}

void test_processor_arrhythmia_hold_does_not_rescue() {  // FIX loop 5 honesty guard: the hold
    // may bridge short dips only — it must never rescue genuine
    // irregularity. Pulses at strict 500/1500 ms alternation for 30 s (the
    // estimator-level arrhythmia class, proven end-to-end). Max spacing
    // 1500 < kIbiPlausibleMaxMs, so the beat-gap rule can NEVER fire —
    // clearing can only come from the hold expiring. Fresh plausibility
    // fails once ≥6 alternating IBIs exist; from kHrValidDropoutMs later
    // the output must read invalid to the end while beats KEEP being
    // detected (detection must be proven present: the rejection would be
    // vacuous on an empty beat train).
    signal::SignalProcessor p;
    signal::SignalWindowOutput last{};
    int closed = 0;
    TimeMs offsets[30];
    offsets[0] = 0;
    for (uint32_t k = 1; k < 30; ++k) {
        offsets[k] = offsets[k - 1] + ((k % 2u == 1u) ? 500u : 1500u);
    }
    int late_windows = 0;
    int late_valid = 0;
    // Windows ending ≥12 s: the EARLIEST possible hold has always expired
    // by then (first plausible verdict ≈3 s, fresh-fails ≈5 s,
    // + kHrValidDropoutMs ⇒ ≈10 s), so any "valid" here is a rescue.
    const TimeMs late_from = 12000;
    for (int sec = 0; sec < 30; ++sec) {
        const TimeMs base = static_cast<TimeMs>(sec) * signal::kMotionWindowMs;
        feedPulseTrainSecond(p, base, offsets, 30, kJitterDcIr, 1200.0f);
        const int before = closed;
        closeDueWindows(p, base + signal::kMotionWindowMs + signal::kMaxSampleGapMs, last, closed);
        if (closed > before && last.window_end_ms >= late_from) {
            ++late_windows;
            if (last.ppg.hr_valid) {
                ++late_valid;
                printf("[T4] LATE VALID window end=%u bpm=%.1f\n",
                       static_cast<unsigned>(last.window_end_ms), last.ppg.hr_bpm);
            }
        }
    }
    TEST_ASSERT_TRUE(closed >= 27);
    // Detection ran — the final window still sees the pulses.
    TEST_ASSERT_TRUE(last.ppg_beat_count >= signal::kMinBeatsForHr);
    // Hold discipline: every window well past expiry reads invalid.
    TEST_ASSERT_TRUE(late_windows >= 3);
    TEST_ASSERT_EQUAL(0, late_valid);
    TEST_ASSERT_FALSE(last.ppg.hr_valid);
}

void test_estimator_missed_beats_tolerated_arrhythmia_rejected() {
    // FIX loop 4 — estimator-level, beat stamps only (no signal needed).
    // (a) Clean train: valid, both consistencies 1.0, bpm 70.6.
    // (b) 5 missed beats out of 11 IBIs (45 % — just under the median-skew
    //     limit): STRICT consistency 6/11 = 0.545 < kMinIbiConsistencyFraction
    //     (would have failed before this fix), miss-tolerant 11/11 → valid,
    //     bpm from the unskewed 600 ms median. This case is the M2
    //     discriminator: remove the 2x band and it must fail.
    // (c) Arrhythmia, IBIs alternating 500 / 1500 ms: neither the 1x band
    //     nor the 2x band catches 500 or 1500 around a 500 ms median
    //     (1500 < 2 x 400% tolerance edge) → consistency 0.556 < 0.6 →
    //     invalid. Arrhythmia must NOT be smoothed into a clean number.
    bw::RingBuffer<TimeMs, signal::kMaxBeatsInHrWindow> beats;

    // (a) clean: 8 beats, 850 ms apart, stamped from t=10 so the
    // half-open (range_start, window_end] lookback keeps them all.
    beats.clear();
    for (uint32_t k = 0; k < 8; ++k) {
        (void)beats.push(static_cast<TimeMs>(10 + k * 850));
    }
    signal::HeartRateResult clean = signal::HeartRateEstimator::estimate(beats, 10000);
    TEST_ASSERT_TRUE(clean.valid);
    TEST_ASSERT_FLOAT_WITHIN(0.01f, 1.0f, clean.consistency);
    TEST_ASSERT_FLOAT_WITHIN(0.01f, 1.0f, clean.consistency_miss_tolerant);
    TEST_ASSERT_FLOAT_WITHIN(3.0f, 70.6f, clean.hr_bpm);

    // (b) 45 % missed: alternating 600 / 1200 ms IBIs (one pulse in two
    // dipped below the floor) — SIX singles + FIVE doubles so the median
    // lands on the 600 ms cluster, bpm 100.
    beats.clear();
    TimeMs t = 10;
    (void)beats.push(t);
    for (uint32_t i = 0; i < 11; ++i) {
        t += (i % 2u == 0u) ? 600 : 1200;  // 600,1200,600,1200,...,600
        (void)beats.push(t);
    }
    signal::HeartRateResult missed = signal::HeartRateEstimator::estimate(beats, 10000);
    TEST_ASSERT_TRUE(missed.valid);  // tolerant fraction 11/11
    TEST_ASSERT_TRUE(missed.consistency < signal::kMinIbiConsistencyFraction);  // 6/11 strict
    TEST_ASSERT_TRUE(missed.consistency_miss_tolerant >= signal::kMinIbiConsistencyFraction);
    TEST_ASSERT_FLOAT_WITHIN(3.0f, 100.0f, missed.hr_bpm);

    // (c) arrhythmia: IBIs alternating 500 / 1500 ms.
    beats.clear();
    t = 10;
    (void)beats.push(t);
    for (uint32_t i = 0; i < 9; ++i) {
        t += (i % 2u == 0u) ? 1500 : 500;
        (void)beats.push(t);
    }
    signal::HeartRateResult arrhythmia = signal::HeartRateEstimator::estimate(beats, 10000);
    TEST_ASSERT_FALSE(arrhythmia.valid);
    TEST_ASSERT_TRUE(arrhythmia.consistency_miss_tolerant < signal::kMinIbiConsistencyFraction);
    TEST_ASSERT_FLOAT_WITHIN(0.0001f, 0.0f, arrhythmia.hr_bpm);
}

void test_processor_ppg_window_diagnostics() {
    // FIX-1 observability pin (2026-10-14): the per-window diagnostics that
    // feed the [PPGWIN] bench line must mirror the frame truth — sample
    // count (≈100 at 100 Hz: proves the drain/timestamp path), beat count,
    // saturation fraction, and the raw IR span (the rail discriminator:
    // min == max == full scale = ADC railed, the H1 defect on hardware).
    // Reverting the closeWindow capture fails every assertion below.
    signal::SignalProcessor p;
    signal::SignalWindowOutput last{};
    int closed = 0;
    for (int sec = 0; sec < 12; ++sec) {
        const TimeMs base = static_cast<TimeMs>(sec) * signal::kMotionWindowMs;
        feedSecond(p, base, kTestPulseAmplitude, 70.0f / 60.0f);
        closeDueWindows(p, base + signal::kMotionWindowMs + signal::kMaxSampleGapMs, last, closed);
    }
    TEST_ASSERT_TRUE(closed >= 11);
    TEST_ASSERT_EQUAL_UINT32(100, last.ppg_sample_count);
    TEST_ASSERT_TRUE(last.ppg_beat_count >= signal::kMinBeatsForHr);
    TEST_ASSERT_FLOAT_WITHIN(0.0001f, 0.0f, last.ppg_saturated_fraction);
    // Synthetic pulse spans ±1000 counts around kTestDcIr; a full window
    // covers >360° of phase, so the observed span is 2000 counts minus at
    // most one sampled point's distance from each peak (~1 % tolerance).
    // Synthetic pulse spans ±1000 counts around kTestDcIr; a full window
    // sweeps >360° of phase, so both extremes sit within one sample step of
    // the true peaks — assert bands, not exact extrema (float sin sampling:
    // no sample is guaranteed to land exactly on a peak).
    const uint32_t ir_span = last.ppg_raw_ir_max - last.ppg_raw_ir_min;
    TEST_ASSERT_TRUE(ir_span > 1900u);
    TEST_ASSERT_TRUE(ir_span <= 2010u);
    TEST_ASSERT_TRUE(last.ppg_raw_ir_min >= 49000u && last.ppg_raw_ir_min <= 49100u);
    TEST_ASSERT_TRUE(last.ppg_raw_ir_max >= 50900u && last.ppg_raw_ir_max <= 51000u);
    // FIX-2 [PPGPK] observability pins (same window): the in-band numbers
    // must show the synthetic pulse standing clear of the noise floor —
    // filtered std ~ A/sqrt(2) ≈ 693 counts (passband gain ~0.98 through
    // the 0.5 Hz HP / 4 Hz LP), strongest local peak ≈ the ±1000-count
    // pulse amplitude, threshold in force above the 0.1 % DC floor, and
    // every threshold-clearing candidate visible. Candidates are per
    // WINDOW (resetObservability at close): a 1 s window of 70 bpm holds
    // 1–2 — the <= 3 bound fails if reset is dropped and they accumulate.
    TEST_ASSERT_TRUE(last.ppg_filtered_std > 600.0f && last.ppg_filtered_std < 800.0f);
    TEST_ASSERT_TRUE(last.ppg_strongest_peak > 850.0f && last.ppg_strongest_peak <= 1050.0f);
    // FIX loop 4: the detection threshold IS the 0.1 % DC floor (the
    // adaptive amplitude term is gone). The detector uses the DC EMA while
    // the window reports the mean, so they agree within the EMA's ~1 %
    // ripple — the upper bound is the de-ratchet pin: any amplitude-inflated
    // bar sneaking back above the floor fails here.
    const float pi_floor = signal::kMinPerfusionIndex * last.ppg.ir_dc_level;
    TEST_ASSERT_TRUE(last.ppg_peak_threshold > 0.99f * pi_floor);
    TEST_ASSERT_TRUE(last.ppg_peak_threshold <= 1.01f * pi_floor);
    TEST_ASSERT_TRUE(last.ppg_strongest_peak > last.ppg_peak_threshold);
    TEST_ASSERT_TRUE(last.ppg_peaks_above_threshold >= 1u);
    TEST_ASSERT_TRUE(last.ppg_candidate_peaks >= last.ppg_peaks_above_threshold);
    TEST_ASSERT_TRUE(last.ppg_candidate_peaks <= 3u);
}

void test_processor_motion_corrupted_flagged() {
    // High IMU energy with a clean PPG: the window must carry
    // motion_corrupted and quality Degraded. HR validity (2026-10-15
    // semantic change) is beat-train plausibility only: the sine train is
    // regular, so hr_valid=true — F12 renders the plain number (the
    // 2026-10-15 evening reversal removed the `~?` marker; quality
    // Degraded still carries the doubt internally). The motion false-HR
    // trade is accepted in the status log; motion gating of HR itself is
    // a separate future item.
    signal::SignalProcessor p;
    signal::SignalWindowOutput last{};
    int closed = 0;
    for (int sec = 0; sec < 8; ++sec) {
        const TimeMs base = static_cast<TimeMs>(sec) * signal::kMotionWindowMs;
        feedSecond(p, base, kTestPulseAmplitude, 70.0f / 60.0f,
                   /*saturated=*/false, /*motion=*/true);
        closeDueWindows(p, base + signal::kMotionWindowMs + signal::kMaxSampleGapMs, last, closed);
    }
    TEST_ASSERT_TRUE(closed > 0);
    TEST_ASSERT_TRUE(last.ppg.motion_corrupted);
    TEST_ASSERT_TRUE(last.ppg.hr_valid);  // plausible train; quality carries the doubt
    TEST_ASSERT_FLOAT_WITHIN(3.0f, 70.0f, last.ppg.hr_bpm);
    TEST_ASSERT_EQUAL(static_cast<int>(DataQuality::Degraded), static_cast<int>(last.ppg.quality));
    // Motion features themselves are still GOOD: the sensor was healthy.
    TEST_ASSERT_EQUAL(static_cast<int>(DataQuality::Good), static_cast<int>(last.motion.quality));
    TEST_ASSERT_TRUE(last.motion.enmo_g > signal::kMaxMotionForValidHrEnmoG);
}

void test_processor_no_data_stall_insufficient() {
    // No samples ever: every window must close as Insufficient with hr_valid
    // false — never a repeated/stale HR (spec §10).
    signal::SignalProcessor p;
    signal::SignalWindowOutput last{};
    int closed = 0;
    closeDueWindows(p, 100000, last, closed);  // far past many window ends
    TEST_ASSERT_TRUE(closed > 1);
    TEST_ASSERT_TRUE(last.has_motion && last.has_ppg);
    TEST_ASSERT_EQUAL(static_cast<int>(DataQuality::Insufficient),
                      static_cast<int>(last.motion.quality));
    TEST_ASSERT_EQUAL(static_cast<int>(DataQuality::Insufficient),
                      static_cast<int>(last.ppg.quality));
    TEST_ASSERT_FALSE(last.ppg.hr_valid);
    TEST_ASSERT_FLOAT_WITHIN(0.0001f, 0.0f, last.ppg.hr_bpm);
    TEST_ASSERT_FALSE(last.ppg.motion_corrupted);  // absence is not motion
    TEST_ASSERT_FLOAT_WITHIN(0.0001f, 0.0f, last.ppg.ir_dc_level);
    // FIX-1 diagnostics: an empty window must report zeroed counters, never
    // leftovers from a previous frame (the [PPGWIN] line reads these).
    TEST_ASSERT_EQUAL_UINT32(0, last.ppg_sample_count);
    TEST_ASSERT_EQUAL_UINT32(0, last.ppg_beat_count);
    TEST_ASSERT_FLOAT_WITHIN(0.0001f, 0.0f, last.ppg_saturated_fraction);
    TEST_ASSERT_EQUAL_UINT32(0, last.ppg_raw_ir_min);
    TEST_ASSERT_EQUAL_UINT32(0, last.ppg_raw_ir_max);
    // FIX-2 [PPGPK] observability: same zeroing contract.
    TEST_ASSERT_FLOAT_WITHIN(0.0001f, 0.0f, last.ppg_filtered_std);
    TEST_ASSERT_FLOAT_WITHIN(0.0001f, 0.0f, last.ppg_strongest_peak);
    TEST_ASSERT_FLOAT_WITHIN(0.0001f, 0.0f, last.ppg_peak_threshold);
    TEST_ASSERT_EQUAL_UINT16(0, last.ppg_candidate_peaks);
    TEST_ASSERT_EQUAL_UINT16(0, last.ppg_peaks_above_threshold);
}

void test_processor_step_until_idle_catches_up_delayed_empty_windows() {
    signal::SignalProcessor p;
    signal::SignalWindowOutput latest{};
    constexpr TimeMs kDelayedNowMs = 299026;

    TEST_ASSERT_TRUE(p.stepUntilIdle(kDelayedNowMs, latest));
    // The 250 ms stall grace makes the final due boundary 298 s; this drains
    // all 298 empty windows in one call without inventing fresh data.
    TEST_ASSERT_EQUAL_UINT64(298000, latest.window_end_ms);
    TEST_ASSERT_TRUE(kDelayedNowMs - latest.window_end_ms < 2 * signal::kMotionWindowMs);
    TEST_ASSERT_TRUE(latest.has_motion && latest.has_ppg);
    TEST_ASSERT_EQUAL(static_cast<int>(DataQuality::Insufficient),
                      static_cast<int>(latest.motion.quality));
    TEST_ASSERT_EQUAL(static_cast<int>(DataQuality::Insufficient),
                      static_cast<int>(latest.ppg.quality));
    TEST_ASSERT_FALSE(latest.ppg.hr_valid);

    TEST_ASSERT_FALSE(p.stepUntilIdle(kDelayedNowMs, latest));
    TEST_ASSERT_EQUAL_UINT64(298000, latest.window_end_ms);
}

void test_processor_boundary_close_with_carry() {
    // A sample at exactly the boundary closes the window even though `now`
    // is still inside the grace period; the sample itself is carried over.
    signal::SignalProcessor p;
    PpgSample ppg[101];
    for (uint32_t i = 0; i < 101; ++i) {
        ppg[i] = mkPpg(i * signal::kPpgSamplePeriodMs, kTestPulseAmplitude, 70.0f / 60.0f);
    }
    p.feedPpg(ppg, 101);  // last sample at t = 1000 crosses the boundary
    ImuSample imu[51];
    for (uint32_t i = 0; i < 51; ++i) {
        imu[i] = mkQuietImu(i * signal::kImuSamplePeriodMs);
    }
    p.feedImu(imu, 51);

    signal::SignalWindowOutput out{};
    TEST_ASSERT_TRUE(p.step(990, out));  // boundary, not stall
    TEST_ASSERT_EQUAL_UINT64(signal::kMotionWindowMs, out.window_end_ms);
    // The boundary sample is parked for the next window: no second close.
    TEST_ASSERT_FALSE(p.step(991, out));
}

void test_processor_backlog_catchup_closes_all_windows() {
    // 1.5 s of data queued, then the task wakes up late: step() must close
    // one window per call and the caller's while-loop catches up (F02 D4).
    signal::SignalProcessor p;
    PpgSample ppg[150];
    for (uint32_t i = 0; i < 150; ++i) {  // t = 0 .. 1490, fits staging (256)
        ppg[i] = mkPpg(i * signal::kPpgSamplePeriodMs, kTestPulseAmplitude, 70.0f / 60.0f);
    }
    p.feedPpg(ppg, 150);

    signal::SignalWindowOutput out{};
    int closed = 0;
    signal::SignalWindowOutput windows[4]{};
    while (p.step(3750, out)) {  // now = 3.75 s: three windows are due
        windows[closed] = out;
        ++closed;
        if (closed >= 4) {
            break;  // defensive bound
        }
    }
    TEST_ASSERT_EQUAL_INT(3, closed);
    // Catch-up order: window ends at 1 s, 2 s, 3 s; the last window has no
    // data at all and must be Insufficient, never a repeat of earlier data.
    TEST_ASSERT_EQUAL_UINT64(signal::kMotionWindowMs, windows[0].window_end_ms);
    TEST_ASSERT_EQUAL_UINT64(2 * signal::kMotionWindowMs, windows[1].window_end_ms);
    TEST_ASSERT_EQUAL_UINT64(3 * signal::kMotionWindowMs, windows[2].window_end_ms);
    TEST_ASSERT_EQUAL(static_cast<int>(DataQuality::Insufficient),
                      static_cast<int>(windows[2].ppg.quality));
    TEST_ASSERT_EQUAL(static_cast<int>(DataQuality::Insufficient),
                      static_cast<int>(windows[2].motion.quality));
    // The partial second window did receive its 50 samples.
    TEST_ASSERT_TRUE(windows[1].ppg.ir_dc_level > 0.0f);
}

void test_processor_backwards_sample_marks_degraded() {
    signal::SignalProcessor p;
    PpgSample ppg[101];
    for (uint32_t i = 0; i < 101; ++i) {
        ppg[i] = mkPpg(i * signal::kPpgSamplePeriodMs, kTestPulseAmplitude, 70.0f / 60.0f);
    }
    p.feedPpg(ppg, 101);
    // One backwards timestamp: dropped at feed, frame flagged (F02 D4).
    PpgSample bad = mkPpg(500, kTestPulseAmplitude, 70.0f / 60.0f);
    p.feedPpg(&bad, 1);

    signal::SignalWindowOutput out{};
    TEST_ASSERT_TRUE(p.step(990, out));
    TEST_ASSERT_TRUE(out.ppg.quality == DataQuality::Degraded ||
                     out.ppg.quality == DataQuality::Insufficient);
    TEST_ASSERT_FALSE(out.ppg.hr_valid);
}

void test_processor_debug_tap_returns_points() {
    signal::SignalProcessor p;
    PpgSample ppg[100];
    for (uint32_t i = 0; i < 100; ++i) {
        ppg[i] = mkPpg(i * signal::kPpgSamplePeriodMs, kTestPulseAmplitude, 70.0f / 60.0f);
    }
    p.feedPpg(ppg, 100);
    signal::SignalWindowOutput out{};
    (void)p.step(1250, out);  // closes window 1 and drains staging

    signal::PpgFilteredPoint buf[64];
    const size_t n = p.copyFilteredPpg(buf, 64);
    TEST_ASSERT_EQUAL_UINT32(64, static_cast<uint32_t>(n));
    TEST_ASSERT_EQUAL_UINT32(static_cast<uint32_t>(kTestDcIr),
                             buf[0].ir_raw);  // first sample, DC at phase 0
    // Filtered first sample ≈ 0: primed steady state (F02 D7).
    TEST_ASSERT_TRUE(std::fabs(buf[0].filtered) < 1.0f);
}

void test_processor_size_within_budget() {
    // Spec §11: RAM ≤ 20 KB. sizeof(SignalProcessor) is the static footprint
    // of the whole feature (staging queues, debug ring, histories, state).
    TEST_ASSERT_LESS_OR_EQUAL_INT(20 * 1024, static_cast<int>(sizeof(signal::SignalProcessor)));
}
